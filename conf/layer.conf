## conf/layer.conf
```bitbake
# We have a conf and classes directory, add to BBPATH
BBPATH := "${BBPATH}:${LAYERDIR}"

# We have a recipes directory, add to BBFILES
BBFILES := "${BBFILES} ${LAYERDIR}/recipes-*/*/*.bb \
            ${LAYERDIR}/recipes-*/*/*.bbappend"

BBFILE_COLLECTIONS += "sbc6845 sbc6845-noscreen"

BBFILE_PATTERN_sbc6845 := "^${LAYERDIR}/"
BBFILE_PRIORITY_sbc6845 = "6"

BBFILE_PATTERN_sbc6845-noscreen := "^${LAYERDIR}/"
BBFILE_PRIORITY_sbc6845-noscreen = "6"
```

## conf/machine/sbc6845-noscreen.conf
```bitbake
#@TYPE: Machine
#@NAME: SBC6845
#@DESCRIPTION: Machine configuration for SBC6845 from www.armkits.org

# Ship all kernel modules by default
MACHINE_EXTRA_RRECOMMENDS = " kernel-modules"

# Uncomment the following line to enable the hard floating point abi. Note that
# this breaks some binary libraries and 3D (neither of which ship with
# meta-yocto). For maximum compatibility, leave this disabled.
#DEFAULTTUNE ?= "cortexa8hf-neon"
require conf/machine/include/tune-arm926ejs.inc

IMAGE_FSTYPES += "tar.bz2 ubi jffs2"
EXTRA_IMAGECMD_jffs2 = "-lnp "

SERIAL_CONSOLE = "115200 ttySAC6"

PREFERRED_PROVIDER_virtual/kernel ?= "linux-sbc6845-noscreen"
PPREFERRED_VERSION_linux-sbc6845 = "3.3%"

# Samsung NAND 256MiB 3,3V 8-bit
# 256MB NAND: ?????
MKUBIFS_ARGS = "-m 2048 -e 126KiB -c 2047"
UBINIZE_ARGS = "-m 2048 -p 128KiB -s 512"

KERNEL_IMAGETYPE = "uImage"

MACHINE_FEATURES = "apm usbhost serial"
```
